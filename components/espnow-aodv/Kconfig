## components/espnow-aodv/Kconfig
```kconfig
menu "AODV Routing Configuration"
    config AODV_MAINTENANCE_INTERVALL
        int "Maintenance Intervall in s"
        default 20
        help
            Time in Seconds
    config AODV_ROUTE_TIMEOUT_AGE
        int "Unused Route Timeout in Intervalls"
        default 6
        help
            Multiple of Garbage Collector Intervall i.e(6*20s=120s). 8-Bit Val so max is 255
    config AODV_PEER_TIMEOUT_AGE
        int "Unresponsive Peer Timeout in Intervalls"
        default 3
        help
            Multiple of Garbage Collector Intervall i.e(3*20s=60s). 8-Bit Val so max is 255
    config AODV_MIN_PEERING_RSSI
        int "Min Peering RSSI in dBm"
        default -85
        help
            Min RSSI of RREQ. If Signal is weaker REEQ will be droped so no instable Routs are created.
    config AODV_ROUTE_TABE_SIZE
        int "Route Table Size"
        default 128
        help
            Limits the max number of Peers in a Network.
    config AODV_RX_BUFFER_SIZE
        int "Size of RX Buffer in Byte"
        default 1028
        help
            Size of RX Buffer in Bytes.
endmenu
```

## sdkconfig.defaults
```kconfig
# Override some defaults in application project.

#
# Serial flasher config
#
CONFIG_ESPTOOLPY_FLASHSIZE_4MB=y
CONFIG_ESPTOOLPY_FLASHMODE_QIO=y
CONFIG_ESPTOOLPY_FLASHFREQ_80M=y
CONFIG_ESPTOOLPY_BAUD_921600B=y

#
# FreeRTOS
#
CONFIG_FREERTOS_HZ=1000
CONFIG_FREERTOS_UNICORE=y
CONFIG_FREERTOS_USE_TRACE_FACILITY=y
CONFIG_FREERTOS_USE_STATS_FORMATTING_FUNCTIONS=y
CONFIG_FREERTOS_VTASKLIST_INCLUDE_COREID=y
CONFIG_FREERTOS_GENERATE_RUN_TIME_STATS=y
CONFIG_FREERTOS_TIMER_TASK_STACK_DEPTH=3072

CONFIG_ESP_TIMER_TASK_STACK_SIZE=4096
CONFIG_ESP_TASK_WDT_PANIC=y
CONFIG_ESP_TASK_WDT_TIMEOUT_S=10

#
# Partition Table for OTA
#
CONFIG_PARTITION_TABLE_SINGLE_APP=n
CONFIG_PARTITION_TABLE_SINGLE_APP_LARGE=n
CONFIG_PARTITION_TABLE_TWO_OTA=y
CONFIG_PARTITION_TABLE_CUSTOM=n

#
# Enable CDC Console Output
#
CONFIG_ESP_CONSOLE_UART_DEFAULT=n
CONFIG_ESP_CONSOLE_USB_CDC=y
CONFIG_ESP_CONSOLE_UART_CUSTOM=n
CONFIG_ESP_CONSOLE_NONE=n
```
